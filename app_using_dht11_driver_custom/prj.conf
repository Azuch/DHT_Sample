## CMakeLists.txt
```
cmake_minimum_required(VERSION 3.20.0)

set(ZEPHYR_EXTRA_MODULES "${CMAKE_SOURCE_DIR}/../dht11_driver_custom")
find_package(Zephyr REQUIRED HINTS $ENV{ZEPHYR_BASE})
project(custom_dht11)

target_sources(app PRIVATE src/main.c)
```

## prj.conf
```kconfig
CONFIG_SENSOR=y
CONFIG_AZUCH_DHT11=y
CONFIG_LOG=y
CONFIG_LOG_DEFAULT_LEVEL=4
```

## boards/esp32s3_devkitc.overlay
```dts
/ {
        aliases {
                dht11 = &dht11_0;
        };

        dht11_0: dht11 {
                compatible = "azuch,dht11";
                status = "okay";
                dio-gpios = <&gpio0 5 (GPIO_ACTIVE_LOW | GPIO_PULL_UP)>;  // GPIO5
        };
};
```

## src/main.c
```c
#include <zephyr/kernel.h>
#include <zephyr/device.h>
#include <zephyr/drivers/sensor.h>
#include <zephyr/logging/log.h>

// Register a log module named "main"
LOG_MODULE_REGISTER(main, LOG_LEVEL_INF);

#define DHT0_NODE DT_ALIAS(dht11)
static const struct device *dev = DEVICE_DT_GET(DHT0_NODE);

int main(void)
{
	if (!device_is_ready(dev)) {
		LOG_ERR("DHT is not ready");
		return 0;
	}

	while (1) {
		struct sensor_value temp, hum;

		if (sensor_sample_fetch(dev) < 0) {
			LOG_ERR("sensor_sample_fetch failed");
			goto sleep;
		}

		if (sensor_channel_get(dev, SENSOR_CHAN_AMBIENT_TEMP, &temp) < 0) {
			LOG_ERR("Failed to read temperature");
			goto sleep;
		}

		if (sensor_channel_get(dev, SENSOR_CHAN_HUMIDITY, &hum) < 0) {
			LOG_ERR("Failed to read humidity");
			goto sleep;
		}

		LOG_INF("Temp: %d.%06d C; Humidity: %d.%06d%%",
		        temp.val1, temp.val2, hum.val1, hum.val2);

	sleep:
		k_sleep(K_SECONDS(2));
	}
}
```
