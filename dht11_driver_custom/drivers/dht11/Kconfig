## dht11_driver_custom/drivers/dht11/Kconfig
```kconfig
menuconfig AZUCH_DHT11
	bool "DHT Temperature and Humidity Sensor"
	default y
	depends on GPIO
	help
	  Enable driver for the DHT temperature and humidity sensor family.

if AZUCH_DHT11

config DHT_LOCK_IRQS
	bool "Lock IRQs for sensor measurement"
	help
	  Locks IRQs when taking sensor readings, this greatly improves the chances of getting a
	  reading successfully from the sensor at the cost of delayed interrupt servicing (e.g.
	  Bluetooth). Note that other systems might need to be adjusted to account for this.

endif # AZUCH_DHT
```

## dht11_driver_custom/dts/bindings/input/azuch,dht11.yaml
```yaml
description: Azuch custom's DHT11 temperature, humidity sensor

compatible: "azuch,dht11"

include: sensor-device.yaml

properties:
  dio-gpios:
    type: phandle-array
    required: true
    description: |
      Pin on which sensor communication will be performed.

      Control and data are encoded by the duration of active low signals. A pull up may be appropriate.

  dht22:
    type: boolean
    description: |
      Set to identify as a DHT22/AM2303. Leave unset to identity sensor as DHT11.
```
